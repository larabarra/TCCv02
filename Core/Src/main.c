
/**
  ******************************************************************************
  * @file           : main.c
  * @brief          : Main program body
  * @date           : Nov 03, 2025
  * @author         : Auto-generated by Config Tool
  ******************************************************************************
  */


/* Includes ------------------------------------------------------------------*/
#include "main.h"
#include <math.h>
#include <stdbool.h>
#include <stdio.h>
#include <string.h>
#include <stdlib.h>

#include "gpio.h"
#include "uart.h"
#include "adc.h"
#include "presets_in.h"
#include "presets_out.h"


/* Private function prototypes -----------------------------------------------*/
void SystemClock_Config(void);

void Presets_Init(void);
void Presets_Process(void);


/**
  * @brief  The application entry point.
  * @retval int
  */
int main(void)
{
  /* MCU Configuration--------------------------------------------------------*/

  /* Reset of all peripherals, Initializes the Flash interface and the Systick. */
  HAL_Init();

  /* Configure the system clock */
  SystemClock_Config();

  /* Initialize all configured peripherals */
  MX_GPIO_Init();
  
  // Configure LED on PA5 (built-in LED on Nucleo)
  __HAL_RCC_GPIOA_CLK_ENABLE();
  GPIO_InitTypeDef LED_InitStruct = {0};
  LED_InitStruct.Pin = GPIO_PIN_5;
  LED_InitStruct.Mode = GPIO_MODE_OUTPUT_PP;
  LED_InitStruct.Pull = GPIO_NOPULL;
  LED_InitStruct.Speed = GPIO_SPEED_FREQ_LOW;
  HAL_GPIO_Init(GPIOA, &LED_InitStruct);
  
  // Blink LED 3 times to show code is running
  for(int i=0; i<3; i++) {
    HAL_GPIO_WritePin(GPIOA, GPIO_PIN_5, GPIO_PIN_SET);
    HAL_Delay(200);
    HAL_GPIO_WritePin(GPIOA, GPIO_PIN_5, GPIO_PIN_RESET);
    HAL_Delay(200);
  }
  
  // Blink once before UART init
  HAL_GPIO_WritePin(GPIOA, GPIO_PIN_5, GPIO_PIN_SET);
  HAL_Delay(100);
  HAL_GPIO_WritePin(GPIOA, GPIO_PIN_5, GPIO_PIN_RESET);
  HAL_Delay(100);
  
  MX_UART_Init();
  
  // Blink twice after UART init (if we get here)
  for(int i=0; i<2; i++) {
    HAL_GPIO_WritePin(GPIOA, GPIO_PIN_5, GPIO_PIN_SET);
    HAL_Delay(100);
    HAL_GPIO_WritePin(GPIOA, GPIO_PIN_5, GPIO_PIN_RESET);
    HAL_Delay(100);
  }
  
  // ADC init with fixed clock configuration
  MX_ADC_Init();
  
  // Blink 3 times to show we skipped ADC
  for(int i=0; i<3; i++) {
    HAL_GPIO_WritePin(GPIOA, GPIO_PIN_5, GPIO_PIN_SET);
    HAL_Delay(100);
    HAL_GPIO_WritePin(GPIOA, GPIO_PIN_5, GPIO_PIN_RESET);
    HAL_Delay(100);
  }

  // Initialize presets
  Presets_Init();
  
  // Send startup message
  const char* startup = "\r\n=== Potentiometer ADC Monitor ===\r\n";
  HAL_UART_Transmit(&huart2, (uint8_t*)startup, strlen(startup), 1000);
  
  const char* msg2 = "Turn the potentiometer!\r\n\r\n";
  HAL_UART_Transmit(&huart2, (uint8_t*)msg2, strlen(msg2), 1000);

  /* Infinite loop - Potentiometer ADC reading */
  while (1)
  {
    Presets_Process();
  }
}

/**
  * @brief System Clock Configuration for STM32G4 series.
  * @retval None
  */
void SystemClock_Config(void)
{
  RCC_OscInitTypeDef RCC_OscInitStruct = {0};
  RCC_ClkInitTypeDef RCC_ClkInitStruct = {0};

  /** Configure the main internal regulator output voltage
  */
  HAL_PWREx_ControlVoltageScaling(PWR_REGULATOR_VOLTAGE_SCALE1);

  /** Initializes the RCC Oscillators according to the specified parameters
  * in the RCC_OscInitTypeDef structure.
  */
  RCC_OscInitStruct.OscillatorType = RCC_OSCILLATORTYPE_HSI;
  RCC_OscInitStruct.HSIState = RCC_HSI_ON;
  RCC_OscInitStruct.HSICalibrationValue = RCC_HSICALIBRATION_DEFAULT;
  RCC_OscInitStruct.PLL.PLLState = RCC_PLL_ON;
  RCC_OscInitStruct.PLL.PLLSource = RCC_PLLSOURCE_HSI;
  RCC_OscInitStruct.PLL.PLLM = RCC_PLLM_DIV4;
  RCC_OscInitStruct.PLL.PLLN = 32;
  RCC_OscInitStruct.PLL.PLLP = RCC_PLLP_DIV2;
  RCC_OscInitStruct.PLL.PLLQ = RCC_PLLQ_DIV2;
  RCC_OscInitStruct.PLL.PLLR = RCC_PLLR_DIV2;
  if (HAL_RCC_OscConfig(&RCC_OscInitStruct) != HAL_OK)
  {
    Error_Handler();
  }

  /** Initializes the CPU, AHB and APB buses clocks
  */
  RCC_ClkInitStruct.ClockType = RCC_CLOCKTYPE_HCLK|RCC_CLOCKTYPE_SYSCLK
                              |RCC_CLOCKTYPE_PCLK1|RCC_CLOCKTYPE_PCLK2;
  RCC_ClkInitStruct.SYSCLKSource = RCC_SYSCLKSOURCE_PLLCLK;
  RCC_ClkInitStruct.AHBCLKDivider = RCC_SYSCLK_DIV1;
  RCC_ClkInitStruct.APB1CLKDivider = RCC_HCLK_DIV1;
  RCC_ClkInitStruct.APB2CLKDivider = RCC_HCLK_DIV1;

  if (HAL_RCC_ClockConfig(&RCC_ClkInitStruct, FLASH_LATENCY_2) != HAL_OK)
  {
    Error_Handler();
  }
}

/* USER CODE BEGIN 4 */

/**
  * @brief  Initialize presets based on configuration
  * @retval None
  */
void Presets_Init(void)
{
  
  
  
  
  
  // ADC initialization for potentiometer
  // ADC already configured in CubeMX
  
  // UART already initialized in MX_UART_Init()
}

/**
  * @brief  Process presets: read input, apply formula, check threshold, set output
  * @retval None
  */
void Presets_Process(void)
{
  
  static uint32_t last_update = 0;
  char buffer[64];  // Buffer for UART/LCD text (increased from 20 to avoid truncation)
  
  
  // Update display every 200ms
  if (HAL_GetTick() - last_update < 200) {
    return;
  }
  last_update = HAL_GetTick();
  
  // ========== Preset: Potentiometer (ADC) -> UART ==========
  
  // Read potentiometer value via ADC
  uint16_t raw_value = 0;
  float processed_value = 0.0f;
  
  // Try reading multiple times and average
  uint32_t sum = 0;
  for(int i=0; i<10; i++) {
    uint16_t temp = 0;
    HAL_StatusTypeDef adc_status = POT_ReadRaw(&hadc1, ADC_CHANNEL_1, &temp);
    if (adc_status == HAL_OK) {
      sum += temp;
    }
    HAL_Delay(1);
  }
  raw_value = sum / 10;
  
  float value = POT_RawToRatio(raw_value);  // Convert to 0.0-1.0 ratio
  // Apply formula: value*15
  processed_value = value*15;
  
  // Process output based on type
  // Send via UART
  // Send potentiometer ADC value via UART
  int16_t proc_int = (int16_t)(processed_value);
  int16_t proc_dec = (int16_t)((processed_value - proc_int) * 100.0f);
  snprintf(buffer, sizeof(buffer), "ADC:%d Raw:%d.%02d\r\n", 
           raw_value, proc_int, abs(proc_dec));
  OUT_UART_Print(buffer);
  
  
  
  
}

/* USER CODE BEGIN 4 (Old examples) */


/* USER CODE END 4 */

/**
  * @brief  This function is executed in case of error occurrence.
  * @retval None
  */
void Error_Handler(void)
{
  /* USER CODE BEGIN Error_Handler_Debug */
  __disable_irq();
  
  // Blink LED in SOS pattern to show error
  while (1)
  {
    // S: 3 short blinks
    for(int i=0; i<3; i++) {
      HAL_GPIO_WritePin(GPIOA, GPIO_PIN_5, GPIO_PIN_SET);
      HAL_Delay(100);
      HAL_GPIO_WritePin(GPIOA, GPIO_PIN_5, GPIO_PIN_RESET);
      HAL_Delay(100);
    }
    HAL_Delay(200);
    
    // O: 3 long blinks
    for(int i=0; i<3; i++) {
      HAL_GPIO_WritePin(GPIOA, GPIO_PIN_5, GPIO_PIN_SET);
      HAL_Delay(300);
      HAL_GPIO_WritePin(GPIOA, GPIO_PIN_5, GPIO_PIN_RESET);
      HAL_Delay(300);
    }
    HAL_Delay(200);
    
    // S: 3 short blinks
    for(int i=0; i<3; i++) {
      HAL_GPIO_WritePin(GPIOA, GPIO_PIN_5, GPIO_PIN_SET);
      HAL_Delay(100);
      HAL_GPIO_WritePin(GPIOA, GPIO_PIN_5, GPIO_PIN_RESET);
      HAL_Delay(100);
    }
    
    HAL_Delay(1000);  // Pause before repeating
  }
  /* USER CODE END Error_Handler_Debug */
}
