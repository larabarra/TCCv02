
/**
  ******************************************************************************
  * @file           : main.c
  * @brief          : Main program body
  * @date           : {{ now().strftime('%b %d, %Y') }}
  * @author         : Auto-generated by Config Tool
  ******************************************************************************
  */


/* Includes ------------------------------------------------------------------*/
#include "main.h"
#include <math.h>
#include <stdbool.h>
#include <stdio.h>
#include <string.h>
#include <stdlib.h>

{# Conditionally include peripheral headers if they have been configured #}
{% if gpio_configs %}
#include "gpio.h"
{% endif %}
{% if i2c_interfaces %}
#include "i2c.h"
{% endif %}
{% if uart_interfaces %}
#include "uart.h"
{% endif %}
{% if adc_interfaces %}
#include "adc.h"
{% endif %}
{% if preset_example_needed %}
#include "presets_in.h"
#include "presets_out.h"
{% endif %}


/* Private function prototypes -----------------------------------------------*/
void SystemClock_Config(void);

{# Generate prototypes for example tasks if they will be created #}
{% if preset_example_needed %}
void Presets_Init(void);
void Presets_Process(void);
{% endif %}
{% if gpio_example_needed %}
static void GPIO_Example_Task(void);
{% endif %}
{% if i2c_example_needed %}
static void I2C_Example_Task(void);
{% endif %}
{% if uart_example_needed %}
static void UART_Example_Task(void);
{% endif %}


/**
  * @brief  The application entry point.
  * @retval int
  */
int main(void)
{
  /* MCU Configuration--------------------------------------------------------*/

  /* Reset of all peripherals, Initializes the Flash interface and the Systick. */
  HAL_Init();

  /* Configure the system clock */
  SystemClock_Config();

  /* Initialize all configured peripherals */
  {% if gpio_configs %}
  MX_GPIO_Init();
  {% endif %}
  {% if i2c_interfaces %}
  MX_I2C_Init();
  {% endif %}
  {% if uart_interfaces %}
  MX_UART_Init();
  {% endif %}
  {% if adc_interfaces %}
  MX_ADC_Init();
  {% endif %}

  {% if preset_example_needed %}
  // Initialize presets based on configuration
  Presets_Init();
  {% endif %}

  /* Infinite loop */
  while (1)
  {
    {% if preset_example_needed %}
    Presets_Process();
    {% endif %}
    {% if gpio_example_needed and not preset_example_needed %}
    GPIO_Example_Task();
    {% endif %}
    {% if i2c_example_needed and not preset_example_needed %}
    I2C_Example_Task();
    {% endif %}
    {% if uart_example_needed and not preset_example_needed %}
    UART_Example_Task();
    {% endif %}
  }
}

/**
  * @brief System Clock Configuration for STM32G4 series.
  * @retval None
  */
void SystemClock_Config(void)
{
  RCC_OscInitTypeDef RCC_OscInitStruct = {0};
  RCC_ClkInitTypeDef RCC_ClkInitStruct = {0};

  /** Configure the main internal regulator output voltage
  */
  HAL_PWREx_ControlVoltageScaling(PWR_REGULATOR_VOLTAGE_SCALE1);

  /** Initializes the RCC Oscillators according to the specified parameters
  * in the RCC_OscInitTypeDef structure.
  */
  RCC_OscInitStruct.OscillatorType = RCC_OSCILLATORTYPE_HSI;
  RCC_OscInitStruct.HSIState = RCC_HSI_ON;
  RCC_OscInitStruct.HSICalibrationValue = RCC_HSICALIBRATION_DEFAULT;
  RCC_OscInitStruct.PLL.PLLState = RCC_PLL_ON;
  RCC_OscInitStruct.PLL.PLLSource = RCC_PLLSOURCE_HSI;
  RCC_OscInitStruct.PLL.PLLM = RCC_PLLM_DIV4;
  RCC_OscInitStruct.PLL.PLLN = 32;
  RCC_OscInitStruct.PLL.PLLP = RCC_PLLP_DIV2;
  RCC_OscInitStruct.PLL.PLLQ = RCC_PLLQ_DIV2;
  RCC_OscInitStruct.PLL.PLLR = RCC_PLLR_DIV2;
  if (HAL_RCC_OscConfig(&RCC_OscInitStruct) != HAL_OK)
  {
    Error_Handler();
  }

  /** Initializes the CPU, AHB and APB buses clocks
  */
  RCC_ClkInitStruct.ClockType = RCC_CLOCKTYPE_HCLK|RCC_CLOCKTYPE_SYSCLK
                              |RCC_CLOCKTYPE_PCLK1|RCC_CLOCKTYPE_PCLK2;
  RCC_ClkInitStruct.SYSCLKSource = RCC_SYSCLKSOURCE_PLLCLK;
  RCC_ClkInitStruct.AHBCLKDivider = RCC_SYSCLK_DIV1;
  RCC_ClkInitStruct.APB1CLKDivider = RCC_HCLK_DIV1;
  RCC_ClkInitStruct.APB2CLKDivider = RCC_HCLK_DIV1;

  if (HAL_RCC_ClockConfig(&RCC_ClkInitStruct, FLASH_LATENCY_2) != HAL_OK)
  {
    Error_Handler();
  }
}

/* USER CODE BEGIN 4 */

{% if preset_example_needed %}
/**
  * @brief  Initialize presets based on configuration
  * @retval None
  */
void Presets_Init(void)
{
  {% set has_lcd = namespace(value=false) %}
  {% set has_mpu6050 = namespace(value=false) %}
  {% for case in preset_cases %}
    {% if case.output_type == "lcd" %}
      {% set has_lcd.value = true %}
    {% endif %}
    {% if case.input_type == "gy521" %}
      {% set has_mpu6050.value = true %}
    {% endif %}
  {% endfor %}
  
  {% set has_dht11 = namespace(value=false) %}
  {% for case in preset_cases %}
    {% if case.input_type == "dht11" %}
      {% set has_dht11.value = true %}
    {% endif %}
  {% endfor %}
  
  {% if has_dht11.value %}
  // Enable DWT cycle counter for microsecond delays (required for DHT11)
  CoreDebug->DEMCR |= CoreDebug_DEMCR_TRCENA_Msk;
  DWT->CYCCNT = 0;
  DWT->CTRL |= DWT_CTRL_CYCCNTENA_Msk;
  {% endif %}
  
  {% if has_lcd.value %}
  // Initialize LCD first
  HAL_Delay(100);
  LCD_Init();
  HAL_Delay(50);
  LCD_Clear();
  
  {% if has_dht11.value %}
  // Display DHT11 startup message
  LCD_SendString("DHT11 Starting...");
  HAL_Delay(2000);  // DHT11 needs 1-2 seconds to stabilize after power-on
  LCD_Clear();
  LCD_SendString("DHT11 Ready");
  HAL_Delay(1000);
  LCD_Clear();
  {% endif %}
  {% endif %}
  
  {% if has_mpu6050.value %}
  {% if has_lcd.value %}
  // Display startup message
  LCD_SendString("MPU6050 Init...");
  HAL_Delay(500);
  {% endif %}
  
  // Initialize MPU6050
  MPU6050_Init();
  HAL_Delay(100);
  
  {% if has_lcd.value %}
  // Show ready message
  LCD_Clear();
  LCD_SendString("MPU6050 Ready!");
  HAL_Delay(1000);
  LCD_Clear();
  {% endif %}
  {% endif %}
  
  {% for case in preset_cases %}
  {% if case.input_type == "dht11" %}
  // DHT11 initialization
  // GPIO pin already configured in MX_GPIO_Init()
  {% elif case.input_type == "potentiometer" %}
  // ADC initialization for potentiometer
  // ADC already configured in CubeMX
  {% endif %}
  
  {% if case.output_type == "uart" %}
  // UART already initialized in MX_UART_Init()
  {% elif case.output_type == "pwm" %}
  // PWM timer already initialized in CubeMX
  {% endif %}
  {% endfor %}
}

/**
  * @brief  Process presets: read input, apply formula, check threshold, set output
  * @retval None
  */
void Presets_Process(void)
{
  {% set needs_timer = namespace(value=false) %}
  {% set needs_buffer = namespace(value=false) %}
  {% for case in preset_cases %}
    {% if case.output_type in ["lcd", "uart"] %}
      {% set needs_timer.value = true %}
      {% set needs_buffer.value = true %}
    {% endif %}
  {% endfor %}
  
  {% if needs_timer.value %}
  static uint32_t last_update = 0;
  {% endif %}
  {% if needs_buffer.value %}
  char buffer[64];  // Buffer for UART/LCD text (increased from 20 to avoid truncation)
  {% endif %}
  
  {% if needs_timer.value %}
  {% set has_dht11_case = namespace(value=false) %}
  {% for case in preset_cases %}
    {% if case.input_type == "dht11" %}
      {% set has_dht11_case.value = true %}
    {% endif %}
  {% endfor %}
  
  {% if has_dht11_case.value %}
  // DHT11 requires minimum 2 second interval between reads
  if (HAL_GetTick() - last_update < 2000) {
    return;
  }
  {% else %}
  // Update display every 200ms
  if (HAL_GetTick() - last_update < 200) {
    return;
  }
  {% endif %}
  last_update = HAL_GetTick();
  {% endif %}
  
  {% for case in preset_cases %}
  // ========== Preset: {{ case.get("input_key", "Unknown") }} -> {{ case.get("output_key", "Unknown") }} ==========
  
  {% if case.input_type == "gy521" %}
  // Read GY-521 (MPU6050) accelerometer data
  float accel_x = 0.0f, accel_y = 0.0f, accel_z = 0.0f;
  MPU6050_Read_Accel(&accel_x, &accel_y, &accel_z);
  
  {% if case.output_type not in ["lcd", "uart"] %}
  // Calculate magnitude (only needed for threshold/PWM outputs)
  float magnitude = sqrt(accel_x * accel_x + accel_y * accel_y + accel_z * accel_z);
  {% if case.get("processing", {}).get("enabled") %}
  // Apply formula: {{ case.get("processing", {}).get("formula", "") }}
  float processed_value = magnitude {{ case.get("processing", {}).get("formula", "") }};
  {% else %}
  float processed_value = magnitude;  // Use raw magnitude
  {% endif %}
  {% endif %}
  
  {% elif case.input_type == "potentiometer" %}
  // Read potentiometer value via ADC
  uint16_t raw_value = 0;
  float processed_value = 0.0f;
  if (POT_ReadRaw(&hadc1, ADC_CHANNEL_0, &raw_value) == HAL_OK)
  {
    float value = POT_RawToRatio(raw_value);  // Convert to 0.0-1.0 ratio
    {% if case.get("processing", {}).get("enabled") %}
    // Apply formula: {{ case.get("processing", {}).get("formula", "") }}
    processed_value = {{ case.get("processing", {}).get("formula", "") }};
    {% else %}
    processed_value = value * 1000.0f;  // Default: scale to 0-1000
    {% endif %}
    
  {% elif case.input_type == "digital_in" %}
  // Read digital input (direct GPIO read, no conversion needed)
  GPIO_PinState din_state = HAL_GPIO_ReadPin(INPUT_PIN_GPIO_Port, INPUT_PIN_Pin);
  
  {% elif case.input_type == "dht11" %}
  // Read DHT11 sensor (returns struct with temperature and humidity)
  DHT11_Data_t dht_data = DHT11_Read();
  
  {% if case.output_type == "lcd" %}
  // For LCD output, we'll display both temp and humidity (no processing needed)
  {% else %}
  // For non-LCD outputs, use temperature as processed value
  if (dht_data.status == HAL_OK)
  {
    float processed_value = (float)dht_data.temp_int + (float)dht_data.temp_dec / 10.0f;
    {% if case.get("processing", {}).get("enabled") %}
    // Apply formula: {{ case.get("processing", {}).get("formula", "") }}
    processed_value = processed_value {{ case.get("processing", {}).get("formula", "") }};
    {% endif %}
  {% endif %}
  
  {% endif %}
  
  // Close the input reading block for sensors that needed it
  {% if case.input_type == "potentiometer" or (case.input_type == "dht11" and case.output_type != "lcd") %}
  }
  {% endif %}
  
  {% if case.output_type in ["digital_out", "pwm"] %}
  // Process the output based on threshold and input type
  {% if case.input_type == "digital_in" %}
  // Digital Input: LED ON when button pressed (active LOW with pull-up)
  bool should_activate = (din_state == GPIO_PIN_RESET);
  {% elif case.get("threshold", {}).get("enabled") and case.input_type == "potentiometer" %}
  // Threshold check for ADC-based inputs (Potentiometer)
  uint16_t threshold = {{ case.get("threshold", {}).get("value", "1000") }};
  bool should_activate = processed_value > threshold;
  {% else %}
  // Always activate for sensors without threshold
  bool should_activate = true;
  {% endif %}
  {% endif %}
  
  // Process output based on type
  {% if case.output_type == "lcd" %}
  // Display on LCD
  LCD_Clear();
  
  {% if case.input_type == "gy521" %}
  // Display MPU6050 accelerometer values (X, Y, Z on separate lines)
  // Convert floats to integers for display (ARM doesn't support %f by default)
  int16_t ax_int = (int16_t)(accel_x * 100.0f);
  int16_t ay_int = (int16_t)(accel_y * 100.0f);
  int16_t az_int = (int16_t)(accel_z * 100.0f);
  
  snprintf(buffer, sizeof(buffer), "X:%d.%02d", ax_int/100, abs(ax_int%100));
  LCD_SendString(buffer);
  
  LCD_SetCursor(1, 0);
  snprintf(buffer, sizeof(buffer), "Y:%d.%02d", ay_int/100, abs(ay_int%100));
  LCD_SendString(buffer);
  
  LCD_SetCursor(2, 0);
  snprintf(buffer, sizeof(buffer), "Z:%d.%02d", az_int/100, abs(az_int%100));
  LCD_SendString(buffer);
  
  {% elif case.input_type == "dht11" %}
  // Display DHT11 temperature and humidity
  if (dht_data.status == HAL_OK)
  {
    // Line 1: Temperature
    snprintf(buffer, sizeof(buffer), "Temp: %d.%d C", dht_data.temp_int, dht_data.temp_dec);
    LCD_SendString(buffer);
    
    // Line 2: Humidity
    LCD_SetCursor(1, 0);
    snprintf(buffer, sizeof(buffer), "Hum:  %d.%d %%", dht_data.hum_int, dht_data.hum_dec);
    LCD_SendString(buffer);
  }
  else
  {
    // Show error with diagnostic info
    LCD_SendString("DHT11 Timeout!");
    LCD_SetCursor(1, 0);
    LCD_SendString("Check: VCC,GND,PA1");
    LCD_SetCursor(2, 0);
    LCD_SendString("Wait 2-3 seconds");
  }
  
  {% else %}
  // Generic display for other sensor types
  if (should_activate)
  {
    LCD_SendString("ACTIVE");
  }
  else
  {
    LCD_SendString("INACTIVE");
  }
  {% endif %}
  
  {% elif case.output_type == "uart" %}
  // Send via UART
  {% if case.input_type == "gy521" %}
  // Send MPU6050 accelerometer data via UART
  // Convert floats to integers for transmission (ARM doesn't support %f by default)
  int16_t ax_int = (int16_t)(accel_x * 100.0f);
  int16_t ay_int = (int16_t)(accel_y * 100.0f);
  int16_t az_int = (int16_t)(accel_z * 100.0f);
  
  snprintf(buffer, sizeof(buffer), "X:%d.%02d Y:%d.%02d Z:%d.%02d\r\n", 
           ax_int/100, abs(ax_int%100),
           ay_int/100, abs(ay_int%100),
           az_int/100, abs(az_int%100));
  OUT_UART_Print(buffer);
  
  {% elif case.input_type == "dht11" %}
  // Send DHT11 data via UART
  if (dht_data.status == HAL_OK)
  {
    snprintf(buffer, sizeof(buffer), "Temp:%d.%d Hum:%d.%d\r\n",
             dht_data.temp_int, dht_data.temp_dec,
             dht_data.hum_int, dht_data.hum_dec);
    OUT_UART_Print(buffer);
  }
  else
  {
    OUT_UART_Print("DHT11_ERROR\r\n");
  }
  
  {% elif case.input_type == "potentiometer" %}
  // Send potentiometer ADC value via UART
  int16_t proc_int = (int16_t)(processed_value);
  int16_t proc_dec = (int16_t)((processed_value - proc_int) * 100.0f);
  snprintf(buffer, sizeof(buffer), "ADC:%d Raw:%d.%02d\r\n", 
           raw_value, proc_int, abs(proc_dec));
  OUT_UART_Print(buffer);
  
  {% else %}
  // Generic UART output
  if (should_activate)
  {
    OUT_UART_Print("ACTIVE\r\n");
  }
  {% endif %}
  
  {% elif case.output_type == "pwm" %}
  // Set PWM duty cycle
  if (should_activate)
  {
    uint16_t duty = (uint16_t)(processed_value * 1000);  // Scale to PWM range
    __HAL_TIM_SET_COMPARE(&htim1, TIM_CHANNEL_1, duty);
  }
  else
  {
    __HAL_TIM_SET_COMPARE(&htim1, TIM_CHANNEL_1, 0);
  }
  
  {% elif case.output_type == "digital_out" %}
  // Set digital output (LED)
  if (should_activate)
  {
    HAL_GPIO_WritePin(OUTPUT_LED_GPIO_Port, OUTPUT_LED_Pin, GPIO_PIN_SET);
  }
  else
  {
    HAL_GPIO_WritePin(OUTPUT_LED_GPIO_Port, OUTPUT_LED_Pin, GPIO_PIN_RESET);
  }
  
  {% endif %}
  
  {% endfor %}
  
  {% if not needs_timer.value %}
  // Small delay for GPIO-only presets to prevent excessive CPU usage
  HAL_Delay(1);
  {% endif %}
}
{% endif %}

/* USER CODE BEGIN 4 (Old examples) */
{% if gpio_example_needed %}
/**
  * @brief  A simple task demonstrating GPIO input and output.
  * @retval None
  */
static void GPIO_Example_Task(void)
{
    {# Generate a more complex example if both input and output are defined #}
    {% if first_gpio_input and first_gpio_output %}
    // Reads the state of the input pin and sets the output pin accordingly.
    if (HAL_GPIO_ReadPin({{ first_gpio_input.name }}_GPIO_Port, {{ first_gpio_input.name }}_Pin) == GPIO_PIN_SET)
    {
        HAL_GPIO_WritePin({{ first_gpio_output.name }}_GPIO_Port, {{ first_gpio_output.name }}_Pin, GPIO_PIN_SET);
    }
    else
    {
        HAL_GPIO_WritePin({{ first_gpio_output.name }}_GPIO_Port, {{ first_gpio_output.name }}_Pin, GPIO_PIN_RESET);
    }
    {% elif first_gpio_output %}
    // Toggles the first configured output pin every 500ms.
    HAL_GPIO_TogglePin({{ first_gpio_output.name }}_GPIO_Port, {{ first_gpio_output.name }}_Pin);
    HAL_Delay(500);
    {% endif %}
}
{% endif %}

{% if i2c_example_needed %}
/**
  * @brief  A simple task demonstrating I2C master communication.
  * @retval None
  */
static void I2C_Example_Task(void)
{
    // Attempts to write a counter value to register 0x01 of the first configured I2C slave device.
    // This is a common pattern for configuring sensors.
    static uint8_t counter = 0;
    HAL_StatusTypeDef status = I2C_Write_Register(&hi2c{{ i2c_interfaces[0].num }}, {{ i2c_interfaces[0].devices[0].name }}_ADDR, 0x01, counter++);
    
    if (status == HAL_OK)
    {
      // Communication successful
    }
    else
    {
      // Communication failed
    }

    HAL_Delay(1000); // Wait 1 second before the next transmission
}
{% endif %}

{% if uart_example_needed %}
/**
  * @brief  A simple task demonstrating UART transmission.
  * @retval None
  */
static void UART_Example_Task(void)
{
    uint8_t msg[] = "Hello from STM32!\r\n";
    
    // Transmit the message via the first configured UART interface.
    // The generated UART_Transmit function handles the selected transfer mode (Polling, IT, or DMA).
    UART_Transmit(&huart{{ uart_interfaces[0].num }}, msg, sizeof(msg) - 1, 100);
    
    HAL_Delay(1000); // Wait 1 second before the next transmission
}
{% endif %}
/* USER CODE END 4 */

/**
  * @brief  This function is executed in case of error occurrence.
  * @retval None
  */
void Error_Handler(void)
{
  /* USER CODE BEGIN Error_Handler_Debug */
  __disable_irq();
  while (1)
  {
  }
  /* USER CODE END Error_Handler_Debug */
}

